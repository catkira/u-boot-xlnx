## configs/zynq_ant_defconfig
```kconfig
CONFIG_ARM=y
CONFIG_SYS_CONFIG_NAME="zynq-common"
CONFIG_ARCH_ZYNQ=y
CONFIG_SYS_MALLOC_F_LEN=0x800
CONFIG_DEFAULT_DEVICE_TREE="zynq-ant"
CONFIG_SPL=y
CONFIG_FIT=y
CONFIG_FIT_VERBOSE=y
CONFIG_FIT_SIGNATURE=y
CONFIG_BOOTDELAY=0
CONFIG_SYS_NO_FLASH=y
CONFIG_HUSH_PARSER=y
CONFIG_SYS_PROMPT="SkyNET> "
CONFIG_TEXT_BASE=0x4000000
CONFIG_ENV_OFFSET=0xE00000
CONFIG_ENV_OFFSET_REDUND=0xE40000
CONFIG_SYS_LOAD_ADDR=0x0
CONFIG_LEGACY_IMAGE_FORMAT=y
CONFIG_USE_PREBOOT=y
CONFIG_CLOCKS=y
CONFIG_CPU_FREQ_HZ=800000000
CONFIG_SYS_CUSTOM_LDSCRIPT=y
CONFIG_SYS_LDSCRIPT="arch/arm/mach-zynq/u-boot.lds"
CONFIG_SPL=y
CONFIG_SPL_FPGA=y
CONFIG_SPL_OS_BOOT=y
CONFIG_SYS_SPL_ARGS_ADDR=0x10000000
CONFIG_SPL_HAS_BSS_LINKER_SECTION=y
CONFIG_SPL_BSS_START_ADDR=0x100000
CONFIG_SPL_BSS_MAX_SIZE=0x100000
CONFIG_SPL_MAX_SIZE=0x30000
CONFIG_SPL_STACK_R_ADDR=0x200000
CONFIG_SPL_STACK=0xfffffe00
CONFIG_SPL_STACK_R=y
CONFIG_SYS_SPL_MALLOC=y
CONFIG_SYS_SPL_MALLOC_SIZE=0x2000000
CONFIG_SILENT_CONSOLE=n
# CONFIG_SYS_DEVICE_NULLDEV

# CONFIG_CMD_IMLS is not set
# CONFIG_CMD_XIMG is not set
# CONFIG_CMD_FLASH is not set

#CONFIG_MTD=y
#CONFIG_MTD_RAW_NAND=y
#CONFIG_NAND_ZYNQ=y
CONFIG_DM_GPIO=y
CONFIG_ZYNQ_GPIO=y
CONFIG_MISC_INIT_R=y
CONFIG_DM_I2C=y
CONFIG_I2C_EEPROM=y
# CONFIG_ZYNQ_I2C0=y
# CONFIG_EEPROM=y

CONFIG_DFU=y
CONFIG_DFU_SF=y

CONFIG_ZYNQ_SDHCI=y
CONFIG_CMD_MMC=y

CONFIG_MMC_SDHCI=y
CONFIG_MMC_SDHCI_ZYNQ=y

CONFIG_SD_BOOT=y

CONFIG_CMD_SF=y
CONFIG_CMD_SPI=y
CONFIG_CMD_USB=y
CONFIG_CMD_DFU=y
CONFIG_CMD_GPIO=y
CONFIG_FPGA_XILINX=y
CONFIG_FPGA_ZYNQPL=y
# CONFIG_CMD_SETEXPR is not set
# CONFIG_CMD_NET is not set
# CONFIG_CMD_NFS is not set
CONFIG_CMD_CACHE=y
CONFIG_CMD_EXT2=y
CONFIG_CMD_EXT4=y
CONFIG_CMD_EXT4_WRITE=y
CONFIG_CMD_FAT=y
CONFIG_CMD_FS_GENERIC=y
CONFIG_OF_SEPARATE=y
CONFIG_SPL_DM_SEQ_ALIAS=y
CONFIG_LED=y
CONFIG_LED_GPIO=y
CONFIG_SPI_FLASH=y
CONFIG_SPI_FLASH_BAR=y
CONFIG_SPI_FLASH_ISSI=y
CONFIG_SPI_FLASH_MACRONIX=y
CONFIG_SPI_FLASH_SPANSION=y
CONFIG_SPI_FLASH_STMICRO=y
CONFIG_SPI_FLASH_WINBOND=y
CONFIG_ZYNQ_QSPI=y
CONFIG_USB=y
CONFIG_USB_EHCI_HCD=y
CONFIG_USB_ULPI_VIEWPORT=y
CONFIG_USB_ULPI=y
CONFIG_USB_STORAGE=y
CONFIG_USB_GADGET=y
CONFIG_CI_UDC=y

CONFIG_USB_GADGET_VBUS_DRAW=500
CONFIG_USB_GADGET_DOWNLOAD=y
CONFIG_G_DNL_MANUFACTURER="Analog Devices Inc."
CONFIG_G_DNL_VENDOR_NUM=0x0456
CONFIG_G_DNL_PRODUCT_NUM=0xb674
CONFIG_REGEX=y
CONFIG_LIB_RAND=y
```
